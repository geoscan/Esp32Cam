## components/buffered_file_transfer/Kconfig.projbuild
```kconfig
menu "[buffered_file_transfer]"

	config BUFFERED_FILE_TRANSFER_ENABLE
		bool "Enable buffered file transfer"
		default n
		help
			AP/ESP channel has low throughput. That is because all the files
			are buffered in RAM, or elsewhere, and then transferred with that
			low-speed channel. From a user's perspective, it looks like
			background flashing.

	choice BUFFERED_FILE_TRANSFER_DEBUG_LEVEL
		prompt "[buffered_file_transfer] module debug level"
		default BUFFERED_FILE_TRANSFER_DEBUG_LEVEL_INFO

		config BUFFERED_FILE_TRANSFER_DEBUG_LEVEL_ERROR
			bool "Error"

		config BUFFERED_FILE_TRANSFER_DEBUG_LEVEL_WARN
			bool "Warning"

		config BUFFERED_FILE_TRANSFER_DEBUG_LEVEL_INFO
			bool "Info"

		config BUFFERED_FILE_TRANSFER_DEBUG_LEVEL_DEBUG
			bool "Debug"

		config BUFFERED_FILE_TRANSFER_DEBUG_LEVEL_VERBOSE
			bool "Verbose"

	endchoice

	config BUFFERED_FILE_TRANSFER_DEBUG_LEVEL
		int
		default 1 if BUFFERED_FILE_TRANSFER_DEBUG_LEVEL_ERROR
		default 2 if BUFFERED_FILE_TRANSFER_DEBUG_LEVEL_WARN
		default 3 if BUFFERED_FILE_TRANSFER_DEBUG_LEVEL_INFO
		default 4 if BUFFERED_FILE_TRANSFER_DEBUG_LEVEL_DEBUG
		default 5 if BUFFERED_FILE_TRANSFER_DEBUG_LEVEL_VERBOSE

	choice BUFFERED_FILE_TRANSFER_BUFFER_FILE_SYSTEM
		prompt "Select buffer file system implementation"
		depends on BUFFERED_FILE_TRANSFER_ENABLE
		default BUFFERED_FILE_TRANSFER_MEMORY_PROVIDER_MALLOC

		config BUFFERED_FILE_TRANSFER_FILE_BUFFER_FILE_SYSTEM_MALLOC_RAM
			bool "malloc()"
			help
				Use malloc()-allocated continuous chunk of memory as buffer

		config BUFFERED_FILE_TRANSFER_FILE_BUFFER_FILE_SYSTEM_MALLOC_RAM_FLUSHING
			bool "Flushing malloc()"
			help
				Same as "MALLOC_RAM", but with flushing
				capabilities when the transferred file's size
				exceeds that of the underlying buffer
	endchoice

	menu "Enable implementors which are used for buffered file transfer"
		depends on BUFFERED_FILE_TRANSFER_ENABLE

		config BUFFERED_FILE_TRANSFER_IMPLEMENTOR_SALUTE_FLASH
			bool "Enable Salute SPI flash memory buffered file transfer implementor"
			help
				If enabled, a subject area-specific instance of BFT implementor
				will be instantiated; this instance will flush intermediate
				results into SPI flash memory (registered system-wide) on every
				transfer process update. This instance will be aware of SPI
				flash memory layout, and file system markup employed by the
				autopilot. The implied layout MUST match that of Autopilot.

	endmenu

endmenu
```

## components/cam/Kconfig.projbuild
```kconfig
menu "[cam]"

config CAM_ENABLE
	bool "Enable camera device"
	default y

if CAM_ENABLE

	choice CAM_MODEL
		prompt "Select camera model"
		help
			Camera model

		config CAM_MODEL_OV2640
			bool "OV2640"
			default y
			depends on OV2640_SUPPORT
		if !OV2640_SUPPORT
			comment "OV2640_SUPPORT -- disabled"
		endif

	endchoice

endif

endmenu
```

## components/camera_recorder/Kconfig.projbuild
```kconfig
menu "[camera_recorder]"

	choice CAMERA_RECORDER_DEBUG_LEVEL
		prompt "[camera_recorder] module debug level"
		default CAMERA_RECORDER_DEBUG_LEVEL_INFO

		config CAMERA_RECORDER_DEBUG_LEVEL_ERROR
			bool "Error"

		config CAMERA_RECORDER_DEBUG_LEVEL_WARN
			bool "Warning"

		config CAMERA_RECORDER_DEBUG_LEVEL_INFO
			bool "Info"

		config CAMERA_RECORDER_DEBUG_LEVEL_DEBUG
			bool "Debug"

		config CAMERA_RECORDER_DEBUG_LEVEL_VERBOSE
			bool "Verbose"


	endchoice

	config CAMERA_RECORDER_DEBUG_LEVEL
        int
        default 1 if CAMERA_RECORDER_DEBUG_LEVEL_ERROR
        default 2 if CAMERA_RECORDER_DEBUG_LEVEL_WARN
        default 3 if CAMERA_RECORDER_DEBUG_LEVEL_INFO
        default 4 if CAMERA_RECORDER_DEBUG_LEVEL_DEBUG
        default 5 if CAMERA_RECORDER_DEBUG_LEVEL_VERBOSE

endmenu
```

## components/camera_streamer/Kconfig.projbuild
```kconfig
menu "JPEG camera streamer"

	config CAMSTREAM_SOURCE_UDP_PORT
		int "Default port device uses for sending frames"
		default 8888

	config CAMSTREAM_SOURCE_TCP_PORT
		int "Default port device uses to accept TCP connection"
		default 8888

	config CAMSTREAM_USE_FPS
		bool "Specify FPS"
		default n
		help
			If disabled, the device sends frames as soon as it acquires them,
			the performance is only determined by camera's latencies

	if CAMSTREAM_USE_FPS

		config CAMSTREAM_FPS
			int "FPS"
			range 1 30
			default 20

	endif

endmenu
```

## components/camera_thread/Kconfig.projbuild
```kconfig
menu "[camera_thread]"

config CAMERA_THREAD_ENABLE
	bool "Enable camera thread"
	default y

config CAMERA_THREAD_PIN_TO_CORE
	int "PIN_TO_CORE: # of core to pin the task"
	range 0 1
	default 1

endmenu
```

## components/deprecated_wifi_uart_bridge/Kconfig.projbuild
```kconfig
menu "Example Configuration"

    choice EXAMPLE_IP_MODE
        prompt "IP Version"
        help
            Example can use either IPV4 or IPV6.

        config EXAMPLE_IPV4
            bool "IPV4"

        config EXAMPLE_IPV6
            bool "IPV6"
            select EXAMPLE_CONNECT_IPV6

    endchoice


endmenu
```

## components/http/Kconfig.projbuild
```kconfig
menu "[http]"

	choice HTTP_DEBUG_LEVEL
		prompt "[http] HTTP debug level"
		default HTTP_DEBUG_LEVEL_INFO

		config HTTP_DEBUG_LEVEL_ERROR
			bool "Error"

		config HTTP_DEBUG_LEVEL_WARN
			bool "Warning"

		config HTTP_DEBUG_LEVEL_INFO
			bool "Info"

		config HTTP_DEBUG_LEVEL_DEBUG
			bool "Debug"

		config HTTP_DEBUG_LEVEL_VERBOSE
			bool "Verbose"

	endchoice

	config HTTP_PAGE_CAMERA_DEMO_ENABLE
		bool "Enable camera demo page"
		default y

	config HTTP_PAGE_INFO_ENABLE
		bool "Enable info page"
		default y

	config HTTP_PAGE_CONTROL_ENABLE
		bool "Enable control page"
		default y

	config HTTP_PAGE_FILE_UPLOAD_ENABLE
		bool "Enable file upload page"
		default n

	config HTTP_DEBUG_LEVEL
		int
		default 1 if HTTP_DEBUG_LEVEL_ERROR
		default 2 if HTTP_DEBUG_LEVEL_WARN
		default 3 if HTTP_DEBUG_LEVEL_INFO
		default 4 if HTTP_DEBUG_LEVEL_DEBUG
		default 5 if HTTP_DEBUG_LEVEL_VERBOSE

endmenu
```

## components/lib/ov2640/Kconfig.projbuild
```kconfig
menu "[ov2640 driver]"

config OV2640_SUPPORT
	bool "OV2640 Support"
	default y
	help
		Enable this option if you want to use the OV2640.
		Disable this option to save memory.

config OV7725_SUPPORT
	bool "OV7725 Support"
	default n
	help
		Enable this option if you want to use the OV7725.
		Disable this option to save memory.

config OV3660_SUPPORT
	bool "OV3660 Support"
	default y
	help
		Enable this option if you want to use the OV3360.
		Disable this option to save memory.

config OV5640_SUPPORT
	bool "OV5640 Support"
	default y
	help
		Enable this option if you want to use the OV5640.
		Disable this option to save memory.

config SCCB_HARDWARE_I2C
	bool "Use hardware I2C for SCCB"
	default y
	help
		Enable this option if you want to use hardware I2C to control the camera.
		Disable this option to use software I2C.

config OV2640_JPEG_BUFFER_SIZE
	int "OV2640_JPEG_BUFFER_SIZE"
	range 0 61440
	default 40960
	help
		Number of bytes the driver will allocate for storing JPEG frames, if JPEG encoding is used.

choice SCCB_HARDWARE_I2C_PORT
	bool "I2C peripheral to use for SCCB"
	depends on SCCB_HARDWARE_I2C
	default SCCB_HARDWARE_I2C_PORT1

	config SCCB_HARDWARE_I2C_PORT0
		bool "I2C0"
	config SCCB_HARDWARE_I2C_PORT1
		bool "I2C1"

endchoice

choice CAMERA_TASK_PINNED_TO_CORE
	bool "Camera task pinned to core"
	default CAMERA_CORE0
	help
		Pin the camera handle task to a certain core(0/1). It can also be done automatically choosing NO_AFFINITY.

	config CAMERA_CORE0
		bool "CORE0"
	config CAMERA_CORE1
		bool "CORE1"
	config CAMERA_NO_AFFINITY
		bool "NO_AFFINITY"

endchoice

config OV2640_CUSTOM_BUFFER_MANAGEMENT
	bool "OV2640_CUSTOM_BUFFER_MANAGEMENT"
	default y
	help

		Default OV2640's driver offers custom implementation of frame buffer
		management, and it really lacks performance on some chips (probably because
		it uses FreeRTOS' queues). This field enables custom buffer management.

if OV2640_CUSTOM_BUFFER_MANAGEMENT
	config OV2640_CUSTOM_BUFFER_MANAGEMENT_N_BUFFERS
		int "OV2640_CUSTOM_BUFFER_MANAGEMENT_N_BUFFERS"
		range 1 3
		default 2
		help
			Enable this option if you want to use the OV2640.
			Disable this option to save memory.
endif

choice DRIVER_OV2640_DEBUG_LEVEL
	prompt "[DRIVER_OV2640] module debug level"
	default DRIVER_OV2640_DEBUG_LEVEL_INFO

	config DRIVER_OV2640_DEBUG_LEVEL_ERROR
		bool "Error"

	config DRIVER_OV2640_DEBUG_LEVEL_WARN
		bool "Warning"

	config DRIVER_OV2640_DEBUG_LEVEL_INFO
		bool "Info"

	config DRIVER_OV2640_DEBUG_LEVEL_DEBUG
		bool "Debug"

	config DRIVER_OV2640_DEBUG_LEVEL_VERBOSE
		bool "Verbose"

endchoice

config DRIVER_OV2640_DEBUG_LEVEL
	int
	default 1 if DRIVER_OV2640_DEBUG_LEVEL_ERROR
	default 2 if DRIVER_OV2640_DEBUG_LEVEL_WARN
	default 3 if DRIVER_OV2640_DEBUG_LEVEL_INFO
	default 4 if DRIVER_OV2640_DEBUG_LEVEL_DEBUG
	default 5 if DRIVER_OV2640_DEBUG_LEVEL_VERBOSE

config OV2640_TRIGGER_RECEIVE_ON_BUFFER_RELEASE
	bool "Trigger acquisition of the next buffer on `esp_camera_fb_return` call"
	default n
	depends on !DRIVER_OV2640_USE_HOOKS
	help
		When using 1 frame buffer, OV2640 driver works according to the
		following sequence.
		1. On `esp_camera_fb_get`, it (1) waits for the falling edge on VSYNC
		pin, (2) starts I2S, which (3) triggers DMA, which (4) signals to "dma
		task" to pack acquired buffers.
		2. When a frame is received, I2S gets stopped;
		3. User code invokes `esp_camera_fb_return`
		4(3). User code calls `esp_camera_fb_get`.

		Enable this option to trigger acquisition of a new frame on
		`esp_camera_fb_get` call.

		Warning: when `DRIVER_OV2640_USE_HOOKS` is selected, the option makes
		no effect.

config DRIVER_OV2640_USE_HOOKS
	bool "Use hooks on driver events"
	help
		Using hooks allows to tap directly into the driver's workflow cutting
		off context switching expenses through using callbacks.

		Warning: When enabled, `esp_camera_fb_get` and `esp_camera_fb_return`
		API calls will cease to work.

		Warning: when used with multiple camera buffers (`fb_count`), the
		behavior is undefined.

endmenu
```

## components/lib/ov2640/ov2640/Kconfig.projbuild
```kconfig
menu "[ov2640 driver]"
      
config OV2640_SUPPORT
	bool "OV2640 Support"
	default y
	help
		Enable this option if you want to use the OV2640.
		Disable this option to save memory.

config OV7725_SUPPORT
	bool "OV7725 Support"
	default n
	help
		Enable this option if you want to use the OV7725.
		Disable this option to save memory.
	
config OV3660_SUPPORT
    bool "OV3660 Support"
    default y
    help
        Enable this option if you want to use the OV3360.
        Disable this option to save memory.
    
config OV5640_SUPPORT
    bool "OV5640 Support"
    default y
    help
        Enable this option if you want to use the OV5640.
        Disable this option to save memory.
    
config SCCB_HARDWARE_I2C
    bool "Use hardware I2C for SCCB"
    default y
    help
        Enable this option if you want to use hardware I2C to control the camera.
        Disable this option to use software I2C.
    
choice SCCB_HARDWARE_I2C_PORT
    bool "I2C peripheral to use for SCCB"
    depends on SCCB_HARDWARE_I2C
    default SCCB_HARDWARE_I2C_PORT1

    config SCCB_HARDWARE_I2C_PORT0
        bool "I2C0"
    config SCCB_HARDWARE_I2C_PORT1
        bool "I2C1"

endchoice

choice CAMERA_TASK_PINNED_TO_CORE
    bool "Camera task pinned to core"
    default CAMERA_CORE0
    help
        Pin the camera handle task to a certain core(0/1). It can also be done automatically choosing NO_AFFINITY.

    config CAMERA_CORE0
        bool "CORE0"
    config CAMERA_CORE1
        bool "CORE1"
    config CAMERA_NO_AFFINITY
        bool "NO_AFFINITY"

endchoice

config OV2640_CUSTOM_BUFFER_MANAGEMENT
	bool "OV2640_CUSTOM_BUFFER_MANAGEMENT"
	default y
	help

		Default OV2640's driver offers custom implementation of frame buffer
		management, and it really lacks performance on some chips (probably because
		it uses FreeRTOS' queues). This field enables custom buffer management.

if OV2640_CUSTOM_BUFFER_MANAGEMENT
	config OV2640_CUSTOM_BUFFER_MANAGEMENT_N_BUFFERS
		int "OV2640_CUSTOM_BUFFER_MANAGEMENT_N_BUFFERS"
		range 1 3
		default 2
		help
			Number of buffers
endif

endmenu
```

## components/log_udp/Kconfig.projbuild
```kconfig
menu "Debug info over UDP"

	config DEBUG_UDP_ENABLE
		bool "Enable sending debug information over UDP"
		default n
		help
			If set, debug information will be redirected to UDP. The system will open UDP socket
			which'll be used for sending debug information to recipients. To be added, a recipient
			should "trigger" the socket by sending an arbitrary message (won't be processed), thus
			it reports its IP/UDP address/port.


	config DEBUG_UDP_PORT
		int "Port number"
		range 1 65535
		default 666
		help
			System's UDP port

	config DEBUG_UDP_MSGLEN
		int "Max message length"
		range 1 65535
		default 60
		help
			Max. length of a debug message transferred over UDP

endmenu
```

## components/mav/Kconfig.projbuild
```kconfig
menu "[mav]"

	choice MAV_DEBUG_LEVEL
		prompt "[mav] module debug level"
		default MAV_DEBUG_LEVEL_INFO

		config MAV_DEBUG_LEVEL_ERROR
			bool "Error"

		config MAV_DEBUG_LEVEL_WARN
			bool "Warning"

		config MAV_DEBUG_LEVEL_INFO
			bool "Info"

		config MAV_DEBUG_LEVEL_DEBUG
			bool "Debug"

		config MAV_DEBUG_LEVEL_VERBOSE
			bool "Verbose"


	endchoice

	config MAV_DEBUG_LEVEL
        int
        default 1 if MAV_DEBUG_LEVEL_ERROR
        default 2 if MAV_DEBUG_LEVEL_WARN
        default 3 if MAV_DEBUG_LEVEL_INFO
        default 4 if MAV_DEBUG_LEVEL_DEBUG
        default 5 if MAV_DEBUG_LEVEL_VERBOSE

endmenu
```

## components/module/Kconfig.projbuild
```kconfig
menu "[module]"

	choice MODULE_DEBUG_LEVEL
		prompt "[module] module debug level"
		default MODULE_DEBUG_LEVEL_INFO

		config MODULE_DEBUG_LEVEL_ERROR
			bool "Error"

		config MODULE_DEBUG_LEVEL_WARN
			bool "Warning"

		config MODULE_DEBUG_LEVEL_INFO
			bool "Info"

		config MODULE_DEBUG_LEVEL_DEBUG
			bool "Debug"

		config MODULE_DEBUG_LEVEL_VERBOSE
			bool "Verbose"


	endchoice

	config MODULE_DEBUG_LEVEL
		int
		default 1 if MODULE_DEBUG_LEVEL_ERROR
		default 2 if MODULE_DEBUG_LEVEL_WARN
		default 3 if MODULE_DEBUG_LEVEL_INFO
		default 4 if MODULE_DEBUG_LEVEL_DEBUG
		default 5 if MODULE_DEBUG_LEVEL_VERBOSE

endmenu
```

## components/rtsp/Kconfig.projbuild
```kconfig
menu "RTSP, RTP server"

	config RTSP_TCP_PORT
		int "RTSP server's TCP port"
		default 554

	config RTP_UDP_PORT
		int "RTP server's UDP port"
		default 4321

endmenu
```

## components/sd_fat/Kconfig.projbuild
```kconfig
menu "[sd_fat]"

	config SD_FAT_MOUNT_POINT
		string "Mount Point"
		default "/sdcard"
		help
			Mount point for FAT File System on connected SD card
	
	config SD_FAT_MAX_OPENED_FILES
		int "Max opened files"
		range 1 20
		default 5
		help
			Max. number of files opened simultaneously

endmenu
```

## components/socket/Kconfig.projbuild
```kconfig
menu "[socket]"

	config SOCKET_SERVER_CLOSE_CLI_DISCONNECT
		bool "Disconnect clients on server port close"
		default y
		help
			If set, when a server socket on a particular port gets closed, so do all the clients connected to the port.

	choice SOCKET_DEBUG_LEVEL
		prompt "[socket] module debug level"
		default SOCKET_DEBUG_LEVEL_INFO

		config SOCKET_DEBUG_LEVEL_ERROR
			bool "Error"

		config SOCKET_DEBUG_LEVEL_WARN
			bool "Warning"

		config SOCKET_DEBUG_LEVEL_INFO
			bool "Info"

		config SOCKET_DEBUG_LEVEL_DEBUG
			bool "Debug"

		config SOCKET_DEBUG_LEVEL_VERBOSE
			bool "Verbose"


	endchoice

	config SOCKET_DEBUG_LEVEL
        int
        default 1 if SOCKET_DEBUG_LEVEL_ERROR
        default 2 if SOCKET_DEBUG_LEVEL_WARN
        default 3 if SOCKET_DEBUG_LEVEL_INFO
        default 4 if SOCKET_DEBUG_LEVEL_DEBUG
        default 5 if SOCKET_DEBUG_LEVEL_VERBOSE

endmenu
```
