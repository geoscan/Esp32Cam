## components/sub/Kconfig.projbuild
```kconfig
menu "[sub]"

	choice SUB_DEBUG_LEVEL
		prompt "[sub] module debug level"
		default SUB_DEBUG_LEVEL_INFO

		config SUB_DEBUG_LEVEL_ERROR
			bool "Error"

		config SUB_DEBUG_LEVEL_WARN
			bool "Warning"

		config SUB_DEBUG_LEVEL_INFO
			bool "Info"

		config SUB_DEBUG_LEVEL_DEBUG
			bool "Debug"

		config SUB_DEBUG_LEVEL_VERBOSE
			bool "Verbose"


	endchoice

	config SUB_DEBUG_LEVEL
        int
        default 1 if SUB_DEBUG_LEVEL_ERROR
        default 2 if SUB_DEBUG_LEVEL_WARN
        default 3 if SUB_DEBUG_LEVEL_INFO
        default 4 if SUB_DEBUG_LEVEL_DEBUG
        default 5 if SUB_DEBUG_LEVEL_VERBOSE

endmenu
```

## components/system/Kconfig.projbuild
```kconfig
menu "[system]"

	choice SYSTEM_DEBUG_LEVEL
		prompt "[system] module debug level"
		default SYSTEM_DEBUG_LEVEL_INFO

		config SYSTEM_DEBUG_LEVEL_ERROR
			bool "Error"

		config SYSTEM_DEBUG_LEVEL_WARN
			bool "Warning"

		config SYSTEM_DEBUG_LEVEL_INFO
			bool "Info"

		config SYSTEM_DEBUG_LEVEL_DEBUG
			bool "Debug"

		config SYSTEM_DEBUG_LEVEL_VERBOSE
			bool "Verbose"


	endchoice

	config SYSTEM_DEBUG_LEVEL
		int
		default 1 if SYSTEM_DEBUG_LEVEL_ERROR
		default 2 if SYSTEM_DEBUG_LEVEL_WARN
		default 3 if SYSTEM_DEBUG_LEVEL_INFO
		default 4 if SYSTEM_DEBUG_LEVEL_DEBUG
		default 5 if SYSTEM_DEBUG_LEVEL_VERBOSE

endmenu
```

## components/tracking/Kconfig.projbuild
```kconfig
menu "[tracking]"

	config TRACKING_ENABLE
		bool "Enable tracking"
		default n

	choice TRACKING_DEBUG_LEVEL
		prompt "[tracking] module debug level"
		default TRACKING_DEBUG_LEVEL_INFO

		config TRACKING_DEBUG_LEVEL_ERROR
			bool "Error"

		config TRACKING_DEBUG_LEVEL_WARN
			bool "Warning"

		config TRACKING_DEBUG_LEVEL_INFO
			bool "Info"

		config TRACKING_DEBUG_LEVEL_DEBUG
			bool "Debug"

		config TRACKING_DEBUG_LEVEL_VERBOSE
			bool "Verbose"


	endchoice

	config TRACKING_DEBUG_LEVEL
		int
		default 1 if TRACKING_DEBUG_LEVEL_ERROR
		default 2 if TRACKING_DEBUG_LEVEL_WARN
		default 3 if TRACKING_DEBUG_LEVEL_INFO
		default 4 if TRACKING_DEBUG_LEVEL_DEBUG
		default 5 if TRACKING_DEBUG_LEVEL_VERBOSE

	config TRACKING_RUN_PROFILE
		bool "Run profiler"
		default n
		help
			Profiler is a small hook on the "on-frame" event that performs
			frame processing (tracking) and outputs FPS. It is used for debugging
			purposes.

			Profiler comes in various flavors, oncluding one that profiles time
			expenses of the cycle without the tracking itself. See
			`TRACKING_RUN_PROFILE` for more info.

	if TRACKING_RUN_PROFILE

		choice TRACKING_RUN_PROFILE_TYPE
			prompt "[tracking] Select profile sequence type"
			default TRACKING_RUN_PROFILE_TYPE_FULL

			config TRACKING_RUN_PROFILE_TYPE_FULL
				bool "Complete sequence: Tracker + Camera driver + Work queue"

			config TRACKING_RUN_PROFILE_TYPE_TRACKER_CAMERA
				bool "Short sequence: Tracker + Camera driver"

			config TRACKING_RUN_PROFILE_TYPE_TRACKER
				bool "Short sequence: Tracker"

			config TRACKING_RUN_PROFILE_TYPE_CAMERA
				bool "Short sequence: Camera driver (Measure camera performance)"

		endchoice

	endif

endmenu
```

## components/uart/Kconfig.projbuild
```kconfig
menu "[uart]"

	choice UART_DEBUG_LEVEL
		prompt "[uart] module debug level"
		default UART_DEBUG_LEVEL_INFO

		config UART_DEBUG_LEVEL_ERROR
			bool "Error"

		config UART_DEBUG_LEVEL_WARN
			bool "Warning"

		config UART_DEBUG_LEVEL_INFO
			bool "Info"

		config UART_DEBUG_LEVEL_DEBUG
			bool "Debug"

		config UART_DEBUG_LEVEL_VERBOSE
			bool "Verbose"


	endchoice

	config UART_DEBUG_LEVEL
        int
        default 1 if UART_DEBUG_LEVEL_ERROR
        default 2 if UART_DEBUG_LEVEL_WARN
        default 3 if UART_DEBUG_LEVEL_INFO
        default 4 if UART_DEBUG_LEVEL_DEBUG
        default 5 if UART_DEBUG_LEVEL_VERBOSE

endmenu
```

## components/version/Kconfig.projbuild
```kconfig
menu "Version"

	config VERSION_STM_ACQ_TIMEOUT_US
		int "STM32's FW version acquisition timeout"
		default 500000
		help
			Timeout to acquire ESP32 Firmware version via UART, microseconds

endmenu
```

## components/wifi/Kconfig.projbuild
```kconfig
menu "[wifi]"

    config ESP_WIFI_SSID
        string "WiFi SSID"
        default "PioneerMini"
        help
            SSID (network name) for the example to connect to.

    config ESP_WIFI_PASSWORD
        string "WiFi Password"
        default "12345678"
        help
            WiFi password (WPA or WPA2) for the example to use.
    config ESP_WIFI_CHANNEL
        int "WiFi Channel"
        range 1 13
        default 1
        help
            WiFi channel (network channel) for the example to use.

    config ESP_MAX_STA_CONN
        int "Maximal STA connections"
        default 1
        help
            Max number of the STA connects to AP.

	choice WIFI_DEBUG_LEVEL
		prompt "[wifi] module debug level"
		default WIFI_DEBUG_LEVEL_INFO

		config WIFI_DEBUG_LEVEL_ERROR
			bool "Error"

		config WIFI_DEBUG_LEVEL_WARN
			bool "Warning"

		config WIFI_DEBUG_LEVEL_INFO
			bool "Info"
			default 1

		config WIFI_DEBUG_LEVEL_DEBUG
			bool "Debug"

		config WIFI_DEBUG_LEVEL_VERBOSE
			bool "Verbose"


	endchoice

	config WIFI_DEBUG_LEVEL
        int
        default 1 if WIFI_DEBUG_LEVEL_ERROR
        default 2 if WIFI_DEBUG_LEVEL_WARN
        default 3 if WIFI_DEBUG_LEVEL_INFO
        default 4 if WIFI_DEBUG_LEVEL_DEBUG
        default 5 if WIFI_DEBUG_LEVEL_VERBOSE

endmenu
```

## components/wifi_uart_bridge/Kconfig.projbuild
```kconfig
menu "[wifi_uart_bridge]"

	config WIFI_UART_BRIDGE_UDP_PORT
		int "UDP port number"
		range 1 32767
		default 8001
		help
			Number of sending/receiving UDP port

	config WIFI_UART_BRIDGE_RX_TX_BUFFER
		int "RC/TX buffers capacity"
		range 1 4096
		default 300
		help
			Capacity of both RX and TX buffers

	config WIFI_UART_BRIDGE_INACTIVE_TIMEOUT_SECONDS
		int "Max client inactivity period, seconds"
		range 1 1800
		default 5
		help
			For how long UDP client can keep silence before copter stops sending him packages

	config WIFI_UART_BRIDGE_MAX_NCLIENTS
		int "Max number of clients"
		range 1 4
		default 1

	config WIFI_UART_BRIDGE_BAUDRATE
		int "ESP32 <=> AutopilotBoard baudrate"
		default 115200
		help
			Baudrate of UART connecting AP board and ESP32 itself

	menu "UDP routing"
		config WIFI_UART_BRIDGE_UDP_MAVLINK_PROCESS
			bool "Process MAVLink messages received on a dedicated MAVLink UDP port"
			default n
			help
				Enable this option, if you want ESP32 to process and respond to incoming MAVLink messages from MAVLink UDP port

		config WIFI_UART_BRIDGE_UDP_MAVLINK_FORWARD
			bool "Forward MAVLink messages to a respective UART"
			default y
			help
				Enable this option, if you want to forward the messages to UART (only if those messages are not addressed to ESP32)
	endmenu

	menu "UART routing"
		config WIFI_UART_BRIDGE_UART_MAVLINK_PROCESS
			bool "Process MAVLink messages received on a dedicated UART"
			default y
			help
				Enable this option, if you want ESP32 to process and respond to incoming MAVLink messages from MAVLink UART

		config WIFI_UART_BRIDGE_UART_MAVLINK_FORWARD
			bool "Forward MAVLink messages to UDP clients from the list"
			default y
			help
				ESP32 maintains a list of UDP clients. Enable this option if you want to forward to them MAVLink messages (only if those messages are not addressed to ESP32)
	endmenu

	menu "TCP routing"
		config WIFI_UART_BRIDGE_TCP_UNNAMED_FORWARD_UART_MAVLINK
			bool "Forward any sequence received at a non-named TCP port to MAVLink UART"
			default y
			help
				ESP32 serves as a TCP/IP socket functionality provider communicating through MAVLink protocol.
				Enable this field, if you want to pack and forward messages received at a non-named TCP port to the dedicated MAVLink UART

		config WIFI_UART_BRIDGE_TCP_UNNAMED_FORWARD_UDP_MAVLINK
			bool "Forward any sequence received at a non-named TCP port to MAVLink UDP clients"
			default n
			help
				ESP32 serves as a TCP/IP socket functionality provider communicating through MAVLink protocol.
				Enable this field, if you want to pack and forward messages received at a non-named TCP port to the clients of the dedicated MAVLink UDP port.

		config WIFI_UART_BRIDGE_TCP_CONNECTION_EVENT_FORWARD_UDP_MAVLINK
			bool "On TCP connect/disconnect event, pack MAVLink Gs Network messages and send them to a dedicated UDP MAVLink port"
			default n
			help
				MAVLink Gs Network subprotocol is used to notify clients upon TCP/IP events, including those regarding connection status.
				By default, the routing module passes those to a dedicated MAVLink UART port.
				This option enables an additional functionality: push those messages to UDP MAVLink port as well.
				Useful for debugging purposes.

	endmenu

	choice WIFI_UART_BRIDGE_DEBUG_LEVEL
		prompt "[mav] module debug level"
		default WIFI_UART_BRIDGE_DEBUG_LEVEL_INFO

		config WIFI_UART_BRIDGE_DEBUG_LEVEL_ERROR
			bool "Error"

		config WIFI_UART_BRIDGE_DEBUG_LEVEL_WARN
			bool "Warning"

		config WIFI_UART_BRIDGE_DEBUG_LEVEL_INFO
			bool "Info"

		config WIFI_UART_BRIDGE_DEBUG_LEVEL_DEBUG
			bool "Debug"

		config WIFI_UART_BRIDGE_DEBUG_LEVEL_VERBOSE
			bool "Verbose"


	endchoice

	config WIFI_UART_BRIDGE_DEBUG_LEVEL
		int
		default 1 if WIFI_UART_BRIDGE_DEBUG_LEVEL_ERROR
		default 2 if WIFI_UART_BRIDGE_DEBUG_LEVEL_WARN
		default 3 if WIFI_UART_BRIDGE_DEBUG_LEVEL_INFO
		default 4 if WIFI_UART_BRIDGE_DEBUG_LEVEL_DEBUG
		default 5 if WIFI_UART_BRIDGE_DEBUG_LEVEL_VERBOSE

endmenu
```

## components/zd35/Kconfig.projbuild
```kconfig
config ZD35_CAN_ENABLE
	bool
	default y if SPI_FLASH_OVERRIDE_CHIP_DRIVER_LIST
	default n

menu "[zd35]"

	comment "[zd35] Cannot provide ZD35 flash memory support."
		depends on !ZD35_CAN_ENABLE

	config ZD35_ENABLED
		bool "Enable ZD35 driver"
		depends on ZD35_CAN_ENABLE

	choice ZD35_DEBUG_LEVEL
		prompt "[zd35] module debug level"
		default ZD35_DEBUG_LEVEL_INFO

		config ZD35_DEBUG_LEVEL_ERROR
			bool "Error"

		config ZD35_DEBUG_LEVEL_WARN
			bool "Warning"

		config ZD35_DEBUG_LEVEL_INFO
			bool "Info"

		config ZD35_DEBUG_LEVEL_DEBUG
			bool "Debug"

		config ZD35_DEBUG_LEVEL_VERBOSE
			bool "Verbose"

	endchoice

	config ZD35_DEBUG_LEVEL
		int
		default 1 if ZD35_DEBUG_LEVEL_ERROR
		default 2 if ZD35_DEBUG_LEVEL_WARN
		default 3 if ZD35_DEBUG_LEVEL_INFO
		default 4 if ZD35_DEBUG_LEVEL_DEBUG
		default 5 if ZD35_DEBUG_LEVEL_VERBOSE
		default 3

endmenu
```

## tools/component_frame/Kconfig.projbuild
```kconfig
menu "[COMPONENT_FRAME]"

	choice COMPONENT_FRAME_UPPER_DEBUG_LEVEL
		prompt "[COMPONENT_FRAME] module debug level"
		default COMPONENT_FRAME_UPPER_DEBUG_LEVEL_INFO

		config COMPONENT_FRAME_UPPER_DEBUG_LEVEL_ERROR
			bool "Error"

		config COMPONENT_FRAME_UPPER_DEBUG_LEVEL_WARN
			bool "Warning"

		config COMPONENT_FRAME_UPPER_DEBUG_LEVEL_INFO
			bool "Info"

		config COMPONENT_FRAME_UPPER_DEBUG_LEVEL_DEBUG
			bool "Debug"

		config COMPONENT_FRAME_UPPER_DEBUG_LEVEL_VERBOSE
			bool "Verbose"


	endchoice

	config COMPONENT_FRAME_UPPER_DEBUG_LEVEL
		int
		default 1 if COMPONENT_FRAME_UPPER_DEBUG_LEVEL_ERROR
		default 2 if COMPONENT_FRAME_UPPER_DEBUG_LEVEL_WARN
		default 3 if COMPONENT_FRAME_UPPER_DEBUG_LEVEL_INFO
		default 4 if COMPONENT_FRAME_UPPER_DEBUG_LEVEL_DEBUG
		default 5 if COMPONENT_FRAME_UPPER_DEBUG_LEVEL_VERBOSE

endmenu
```
